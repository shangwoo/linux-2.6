## Documentation/devicetree/bindings/mtd/evatronix-nand.txt
```
Evatronix NANDFLASH-CTRL NAND flash controller

Required properties:
- compatible : "evatronix,nandflash-ctrl"
- reg : specify bus address and register area size.
- interrupts : controller interrupt number and irq type.
- nand-ecc-mode : See nand.txt. Supported values "hw", "soft_bch".
- nand-ecc-strength : See nand.txt. Supported values: 4, 8, 16, 24, 32.
- nand-ecc-step-size : See nand.txt. Supported values: 256, 512, 1024.

Optional properties:
- nand-on-flash-bbt: See nand.txt.

Example:

nand: nand@f801e000 {
	compatible = "evatronix,nandflash-ctrl";
	reg = <0xf801e000 0x0200>;
	interrupts = <0 139 IRQ_TYPE_LEVEL_HIGH>;
	/* ONFi mode 0 timing. */
	/* Order is TIME_SEQ_0, TIME_SEQ_1, TIMINGS_ASYN,
	 * TIME_GEN_SEQ_0, _1, _2, _3 */
	timings = <0x0d151533 0x000b0515 0x00000046
		   0x00150000 0x00000000 0x00000005 0x00000015>;
	nand-ecc-mode = "hw";
	nand-on-flash-bbt;
	nand-ecc-strength = <8>;
	nand-ecc-step-size = <512>;
};
```

## arch/arm/mach-as9260/Kconfig
```kconfig
if MACH_AS9260

menu "ASM9260T EVK Uart Enable"

config ENABLE_UART0
	bool "Enable UART0"
	depends on SERIAL_ASM9260
	default n

config ENABLE_UART1
	bool "Enable UART1"
	depends on SERIAL_ASM9260
	default n

config ENABLE_UART2
	bool "Enable UART2"
	depends on SERIAL_ASM9260
	default n


config ENABLE_UART3
	bool "Enable UART3"
	depends on SERIAL_ASM9260
	default n


config ENABLE_UART4
	bool "Enable UART4"
	depends on SERIAL_ASM9260
	default n


config ENABLE_UART5
	bool "Enable UART5"
	depends on SERIAL_ASM9260
	default n


config ENABLE_UART6
	bool "Enable UART6"
	depends on SERIAL_ASM9260
	default n


config ENABLE_UART7
	bool "Enable UART7"
	depends on SERIAL_ASM9260
	default n


config ENABLE_UART8
	bool "Enable UART8"
	depends on SERIAL_ASM9260
	default n


config ENABLE_UART9
	bool "Enable UART9"
	depends on SERIAL_ASM9260
	default n

endmenu


endif
```

## arch/arm/mach-asm9260/Kconfig
```kconfig
config MACH_ASM9260
	bool "Alphascale ASM9260"
	depends on ARCH_MULTI_V5
	select IRQ_MXS
	select ASM9260_TIMER
	select CPU_ARM926T
	help
	  Support for Alpascale ASM9260 based platform.
```

## drivers/char/can/Kconfig
```kconfig
#
# can device configuration
#

menu "CAN character devices"



config CHAR_CAN
       tristate 'CHAR_CAN'
       help
         This enables the CAN.


endmenu
```

## drivers/net/asmmac/Kconfig
```kconfig
config ASM9260_MAC
	tristate "ASM9260 10/100 Ethernet driver"
	depends on HAS_IOMEM
	select NET_CORE
	select MII
	select PHYLIB
	select CRC32
	---help---
	  This is the driver for the Ethernet IPs are built around a
	  Synopsys IP Core and only tested on the ASM9260
	  platforms.

if ASM9260_MAC

config ASM9260_MAC_PLATFORM
	bool "ASM9260 Platform bus support"
	depends on ASM9260_MAC
	default y
	---help---
	  This selects the platform specific bus support for
	  the asmmac device driver. This is the driver used
	  on many embedded ASM9260 platforms based on ARM and SuperH
	  processors.
	  If you have a controller with this interface, say Y or M here.

	  If unsure, say N.

config ASM9260_MAC_TIMER
	bool "ASM9260 Timer optimisation"
	default n
	depends on RTC_HCTOSYS_DEVICE
	---help---
	  Use an external timer for mitigating the number of network
	  interrupts. Currently, for SH architectures, it is possible
	  to use the TMU channel 2 and the SH-RTC device.

choice
        prompt "Select Timer device"
        depends on ASM9260_MAC_TIMER

config ASM9260_MAC_TMU_TIMER
        bool "TMU channel 2"
        depends on CPU_SH4
	---help---

config ASM9260_MAC_RTC_TIMER
        bool "Real time clock"
        depends on RTC_CLASS
	---help---

endchoice

choice
	prompt "Select the DMA TX/RX descriptor operating modes"
	depends on ASM9260_MAC
	---help---
	  This driver supports DMA descriptor to operate both in dual buffer
	  (RING) and linked-list(CHAINED) mode. In RING mode each descriptor
	  points to two data buffer pointers whereas in CHAINED mode they
	  points to only one data buffer pointer.

config ASM9260_MAC_RING
	bool "Enable Descriptor Ring Mode"

config ASM9260_MAC_CHAINED
	bool "Enable Descriptor Chained Mode"

endchoice


endif
```
