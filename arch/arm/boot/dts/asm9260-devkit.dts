/dts-v1/;
#include "asm9260.dtsi"

/ {
	model = "Alphascale asm9260 Development Kit";
	compatible = "alphascale,asm9260devkit", "alphascale,asm9260";

	chosen {
		bootargs = "mem=32M earlyprintk=serial console=ttyS4,115200n8 root=/dev/mtdblock1 init=/linuxrc mtdparts=NAND:4M@10M(logo)ro,60M@14M(root)ro";
	};

};
&uart4 {
	status = "okay";
};
